## examples/iperf_runner/main/Kconfig.projbuild
```kconfig
menu "Example Configuration"

    config EXAMPLE_ROUTER_SSID
        string "Router SSID"
        default "myssid"
        help
            SSID (network name) for the example to connect to.

    config EXAMPLE_ROUTER_PASSWORD
        string "Router Password"
        default "mypassword"
        help
            Router password for the example to use.

endmenu
```

## sdkconfig.defaults
```kconfig
# Enable C++ exceptions and set emergency pool size for exception objects
CONFIG_COMPILER_CXX_EXCEPTIONS=y
CONFIG_COMPILER_CXX_EXCEPTIONS_EMG_POOL_SIZE=1024

# Enable LWIP NAPT needed for custom network interface
CONFIG_LWIP_L2_TO_L3_COPY=y
CONFIG_LWIP_IP_FORWARD=y
CONFIG_LWIP_IPV4_NAPT=y
```

## test/sdkconfig.defaults
```kconfig
# need to disable watch dog because test menu is blocking
CONFIG_ESP_TASK_WDT_INIT=n

# unity
CONFIG_UNITY_ENABLE_COLOR=y
CONFIG_UNITY_ENABLE_BACKTRACE_ON_FAIL=y
```
